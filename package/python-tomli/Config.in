## package/python-tomli/Config.in
```kconfig
config BR2_PACKAGE_PYTHON_TOMLI
	bool "python-tomli"
	help
	  A lil' TOML parser.

	  https://github.com/hukkin/tomli

config BR2_PACKAGE_HOST_PYTHON_TOMLI
    	bool "host python-tomli"
    	help
      	  A lil' TOML parser
```

## package/python-tomli/Config.in.host
```kconfig
config BR2_PACKAGE_HOST_PYTHON_TOMLI
    	bool "host-python-tomli"
    	help
      	  A lil' TOML parser
```

## package/python3/Config.in.host
```kconfig
config BR2_PACKAGE_HOST_PYTHON3
	bool "host python3"
	help
	  The python language interpreter. Host package.

	  http://www.python.org/

if BR2_PACKAGE_HOST_PYTHON3

config BR2_PACKAGE_HOST_PYTHON3_BZIP2
	bool "bzip2"
	help
	  bz2 module for host Python3.

config BR2_PACKAGE_HOST_PYTHON3_SSL
	bool "ssl"
	select BR2_PACKAGE_HOST_OPENSSL
	help
	  _ssl module for host Python3.

config BR2_PACKAGE_HOST_PYTHON3_PIP
    	bool "host python3 pip"
    	help
      	  The PyPA recommended tool for installing Python packages.

config BR2_PACKAGE_HOST_PYTHON3_TOMLI
    	bool "host python3 tomli"
    	select BR2_PACKAGE_HOST_PYTHON3_PIP
    	help
      	  TOML parser for Python 3 host package.
endif
```
